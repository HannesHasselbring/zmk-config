## config/boards/shields/34keys_handwired/Kconfig.defconfig
```kconfig
if SHIELD_34KEYS_HANDWIRED
config ZMK_KEYBOARD_NAME
    default "34Keys Handwired"

endif
```

## config/boards/shields/34keys_handwired/Kconfig.shield
```kconfig
# Copyright (c) 2023 Hannes Hasselbring
# SPDX-License-Identifier: MIT

config SHIELD_34KEYS_HANDWIRED
    def_bool $(shields_list_contains,34keys_handwired)
```
